#include <Wire.h>
#include <Adafruit_SSD1306.h>
#include <Adafruit_GFX.h>

#define DEBUG 0
#define SLAVE_ADDRESS 0x04
#define VERSION_NUMBER 1.00

#define IR_REMREC_PIN 4
#define IR_EMIT_PIN 3

#define MOTOR_LEFT_A 5
#define MOTOR_LEFT_B 6
#define MOTOR_RIGHT_A 10
#define MOTOR_RIGHT_B 9

#define FRONT_LEFT_LED 12
#define FRONT_RIGHT_LED 11
#define BACK_LEFT_LED  7
#define BACK_RIGHT_LED  8
#define Z_LED 13        //this Z led indicates when Arduino is using the I2C bus
#define BUZZER_PIN 14

#define MUX_OUTPUT 21
#define MUX_S0 15
#define MUX_S1 16
#define MUX_S2 17

#define BATT_LVL_PIN 20

//Each battery will reach different max voltages. For example: 4.17, 4.20.
#define USB_VOLTAGE_DETECTED 1.7
#define MIN_BATTERY_VOLTAGE 3.45
#define MAX_BATTERY_VOLTAGE 4.14

#define RIGHT_FRONT_IR  1
#define LEFT_FRONT_IR   6

#define RIGHT_BOTTOM_IR 2
#define LEFT_BOTTOM_IR  4

#define RIGHT_REAR_IR   3
#define LEFT_REAR_IR    5

#define USB_POWER_DETECTED 1    // only usb power "charging" (voltage < USB_VOLTAGE_DETECTED)
#define LOW_BATTERY_DETECTED 2  // low batt mode (USB_VOLTAGE_DETECTED < voltage < MIN_BATTERY_VOLTAGE ) 
#define GOOD_BATTERY_DETECTED 3 // battery detected and in working condition (voltage > MIN_BATTERY_VOLTAGE)

// stringification for Arduino IDE version
// for displaying the version of Arduino over Serial
#define xstr(s) str(s)
#define str(s) #s

//setup for OLED
#define RESET_PIN -1 //null parameter
#define SCREEN_WIDTH 128
#define SCREEN_HEIGHT 64

// Initialize a display
Adafruit_SSD1306 display(SCREEN_WIDTH, SCREEN_HEIGHT, &Wire, RESET_PIN);

// Initialize an array to contain the data that is sent to the Pi on request
byte outputArray[7];  // Elements 0-5 contain IR sensor readings, while 6 contains the current motor speed

// Variables to handle LED states
byte LEDbyte = 0;
byte LEDcount = 0;  //to handle the timing for the LED's
bool LEDtoggle = 0; //to handle the on/off toggling of the LED's

// Variables to handle notes
int noteType = -1;
int noteDuration;

// Variables to handle battery voltage
//volatile double bitsPerVolts = 0;
double batteryVoltage = 0.0;
byte batteryCount = 0;//for battery timer
byte chargingState = 0;

byte bootupCounter = 0; //keeps track of counter that disables charge only mode
byte wakingUpProgress = 0;
bool arduinoI2CMaster = true;
bool chargeOnlyMode = false;
bool PiBooted = false;
bool displayWarning = false;


byte goodIRvalue = 250;
byte value;
int right;
int left;
int r;
int l;

static const unsigned char PROGMEM RIGHT[] =
{
  B00000000, B00000000, B00000000, B00000000, B00000000, B00000000, B00000000, B00000000, B00000000, B00000000, B00000000, B00000000, B00000000, B00000000, B00000000, B00000000,
  B00000000, B00000000, B00000000, B00000000, B00000000, B00000000, B00000000, B00000000, B00000000, B00000000, B00000000, B00000000, B00000000, B00000000, B00000000, B00000000,
  B00000000, B00000000, B00000000, B00000000, B00000000, B00000000, B00000000, B00000000, B00000000, B00000000, B00000000, B00000000, B00000000, B00000000, B00000000, B00000000,
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  B00000000, B00000000, B00000000, B00000000, B00000000, B00000000, B00000000, B00000000, B00000000, B00000000, B00000000, B00000000, B00000000, B00000000, B00000000, B00000000
};



static const unsigned char PROGMEM LEFT[] =
{
  B00000000, B00000000, B00000000, B00000000, B00000000, B00000000, B00000000, B00000000, B00000000, B00000000, B00000000, B00000000, B00000000, B00000000, B00000000, B00000000,
  B00000000, B00000000, B00000000, B00000000, B00000000, B00000000, B00000000, B00000000, B00000000, B00000000, B00000000, B00000000, B00000000, B00000000, B00000000, B00000000,
  B00000000, B00000000, B00000000, B00000000, B00000000, B00000000, B00000000, B00000000, B00000000, B00000000, B00000000, B00000000, B00000000, B00000000, B00000000, B00000000,
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  B00000000, B00000000, B00000000, B00000000, B00000000, B00000000, B00000000, B00000000, B00000000, B00000000, B00000000, B00000000, B00000000, B00000000, B00000000, B00000000
};


static const unsigned char PROGMEM angry[] =
{
  B00000000, B00000000, B00000000, B00000000, B00000000, B00000000, B00000000, B00000000, B00000000, B00000000, B00000000, B00000000, B00000000, B00000000, B00000000, B00000000,
  B00000000, B00000000, B00000000, B00000000, B00000000, B00000000, B00000000, B00000000, B00000000, B00000000, B00000000, B00000000, B00000000, B00000000, B00000000, B00000000,
  B00000000, B00000000, B00000000, B00000000, B00000000, B00000000, B00000000, B00000000, B00000000, B00000000, B00000000, B00000000, B00000000, B00000000, B00000000, B00000000,
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  B00000000, B00000000, B00000000, B00000000, B00000000, B00000000, B00000000, B00000000, B00000000, B00000000, B00000000, B00000000, B00000000, B00000000, B00000000, B00000000
};


static const unsigned char PROGMEM STOP[] =
{
  B00000000, B00000000, B00000000, B00000000, B00000000, B00000000, B00000000, B00000000, B00000000, B00000000, B00000000, B00000000, B00000000, B00000000, B00000000, B00000000,
  B00000000, B00000000, B00000000, B00000000, B00000000, B00000000, B00000000, B00000000, B00000000, B00000000, B00000000, B00000000, B00000000, B00000000, B00000000, B00000000,
  B00000000, B00000000, B00000000, B00000000, B00000000, B00000000, B00000000, B00000000, B00000000, B00000000, B00000000, B00000000, B00000000, B00000000, B00000000, B00000000,
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  B00000000, B00000000, B00000000, B00000000, B00000000, B00000000, B00000000, B00000000, B00000000, B00000000, B00000000, B00000000, B00000000, B00000000, B00000000, B00000000
};
void setup() {
  // put your setup code here, to run once:
  pinMode(MOTOR_LEFT_A, OUTPUT);
  pinMode(MOTOR_LEFT_B, OUTPUT);
  pinMode(MOTOR_RIGHT_A, OUTPUT);
  pinMode(MOTOR_RIGHT_B, OUTPUT);
  pinMode(FRONT_LEFT_LED, OUTPUT);
  pinMode(FRONT_RIGHT_LED, OUTPUT);
  pinMode(BACK_LEFT_LED, OUTPUT);
  pinMode(BACK_RIGHT_LED, OUTPUT);
  pinMode(MUX_S0, OUTPUT);
  pinMode(MUX_S1, OUTPUT);
  pinMode(MUX_S2, OUTPUT);
  pinMode(IR_EMIT_PIN, OUTPUT);

  display.begin(SSD1306_SWITCHCAPVCC, 0x3C);
  display.clearDisplay(); //create  cleared display image
  display.display(); //display the cleared image

  display.setTextSize(1);
  display.setTextColor(WHITE);
  display.setCursor(0, 0);// Start at top-left corner
  
  Wire.begin(SLAVE_ADDRESS);
  Wire.onReceive(receiveData);
  Serial.begin(115200);
}
void chargingSound()
{
  int melody[] = {1000, 1000, 1000};
  int tempo[] = {25, 25, 25};
  SoundProcess(melody, tempo, 7);
}

void bangbang()
{
  int melody[] = {200,200};
  int tempo[] = {5,5};
  SoundProcess(melody, tempo, 2);
  delay(1000);
}
//----------------------------------------------------------------------------------//
void chujeok()
{
  int melody[] = {1216, 1216};
  int tempo[] = {64, 8};

  SoundProcess(melody, tempo, 2);
}

void batteryPowerBeep()
{
  int melody[] = {2437, 1968, 1216, 900};
  int tempo[] = {25, 25, 25, 25};
  SoundProcess(melody, tempo, 3);
}


//----------------------------------------------------------------------------------//
void wakeUpSound()
{
  //  int melody[] = {1319, 1568, 2637, 2093, 2349, 3136};
  //  int tempo[] = {25, 25, 25, 25, 25, 25};
  int melody[] = {1319, 1568, 2637, 2093, 2349, 3136};
  int tempo[] = {25, 25, 25, 25, 25, 25};
  SoundProcess(melody, tempo, 6);

}
//----------------------------------------------------------------------------------//

void Sound_Coin()
{
  int melody[] = {988, 1319};
  int tempo[] = {16, 2};
  SoundProcess(melody, tempo, 2);
}
//----------------------------------------------------------------------------------//

void Sound_FireBall()
{
  int melody[] = {392, 784, 1568};
  int tempo[] = {36, 36, 36};
  SoundProcess(melody, tempo, 3);
}

//----------------------------------------------------------------------------------//
void SoundProcess(int _melody[], int _tempo[], int _size)
{
  for (int thisNote = 0; thisNote < _size; thisNote++)
  {
    int noteDuration = 1000 / _tempo[thisNote];
    tone(BUZZER_PIN, _melody[thisNote], noteDuration);
    int pauseBetweenNotes = noteDuration * 1.30;
    delay(pauseBetweenNotes);
  }
}

byte readIR(int indexOfIRSensor, bool emitterOn){
  
  switch (indexOfIRSensor) {

    case 1://Y1 rightFrontIR
      //001 = 1
      digitalWrite(15, HIGH);
      digitalWrite(16, LOW);
      digitalWrite(17, LOW);
      
      if (emitterOn) digitalWrite(IR_EMIT_PIN, HIGH);
      else digitalWrite(IR_EMIT_PIN, LOW);

      delayMicroseconds(100);  // Allow the voltage to rise a bit after switching on the multiplexer

      value = analogRead(MUX_OUTPUT) / 4;  // Reduce voltage to a value between 0-255 for sending over I2C
      // Serial.println(value);
      digitalWrite(IR_EMIT_PIN, LOW);

      return value;
      break;
  
    case 6://Y6 leftFrontIR
      //110 = 6
      digitalWrite(15, LOW);
      digitalWrite(16, HIGH);
      digitalWrite(17, HIGH);
      
      if (emitterOn) digitalWrite(IR_EMIT_PIN, HIGH);
      else digitalWrite(IR_EMIT_PIN, LOW);

      delayMicroseconds(100);  // Allow the voltage to rise a bit after switching on the multiplexer

      value = analogRead(MUX_OUTPUT) / 4;  // Reduce voltage to a value between 0-255 for sending over I2C
      // Serial.println(value);
      digitalWrite(IR_EMIT_PIN, LOW);

      return value;
      break;

  }
  
  if (emitterOn) digitalWrite(IR_EMIT_PIN, HIGH);
  else digitalWrite(IR_EMIT_PIN, LOW);

  delayMicroseconds(100);  // Allow the voltage to rise a bit after switching on the multiplexer

  byte value = analogRead(MUX_OUTPUT) / 4;  // Reduce voltage to a value between 0-255 for sending over I2C
  //Serial.println(value);
  digitalWrite(IR_EMIT_PIN, LOW);

  return value;

}


void loop() {
receiveData(1);
delay(1);
}

void receiveData(int howmany){
  while(Wire.available()){
    int c = Wire.read();
    int a = c;
    right = readIR(1, HIGH);
    left = readIR(6, HIGH);
    
    if(a>=10 &&a<20)
    {
    a=-(a-10);  
    }
   //Serial.println(a);
    //goodvalue
    if(c>200){
      chujeok();
      digitalWrite(FRONT_RIGHT_LED, HIGH);
      digitalWrite(FRONT_LEFT_LED, HIGH);
      digitalWrite(BACK_LEFT_LED, HIGH);
      digitalWrite(BACK_RIGHT_LED, HIGH);
      


     // Angry();
      if (readIR(RIGHT_FRONT_IR, true) > goodIRvalue){
        Serial.println(F("right front IR sensor failed"));
        digitalWrite(FRONT_RIGHT_LED, HIGH);
        digitalWrite(FRONT_LEFT_LED, HIGH);
        delay(100);
        digitalWrite(FRONT_RIGHT_LED, LOW);
        digitalWrite(FRONT_LEFT_LED, LOW);
        delay(100);
        }
      else{
        readIR(1,HIGH);
        readIR(6,HIGH);
        int kk=readIR(1,HIGH)-readIR(6,HIGH);
        kk=kk/3;
        if(readIR(1,HIGH)>200 && readIR(6,HIGH)>200){//when purple is too far just go straight
          analogWrite(MOTOR_LEFT_A, 36+20);
          analogWrite(MOTOR_LEFT_B, 0);
          analogWrite(MOTOR_RIGHT_A, 33+20);
          analogWrite(MOTOR_RIGHT_B, 0);
          }
        
        else if(readIR(1,HIGH)<50 or readIR(6,HIGH)<50){//when purple is too close zumi stops
          Serial.println("stop");
          analogWrite(MOTOR_LEFT_A, 0);
          analogWrite(MOTOR_LEFT_B, 0);
          analogWrite(MOTOR_RIGHT_A, 0);
          analogWrite(MOTOR_RIGHT_B, 0);
          }
        
        else{//else zumi follows purple
          analogWrite(MOTOR_LEFT_A, 36-kk+20);
          analogWrite(MOTOR_LEFT_B, 0);
          analogWrite(MOTOR_RIGHT_A, 33+kk+20);
          analogWrite(MOTOR_RIGHT_B, 0);
          }
       }
    }
    else if(c==100)
    {
      analogWrite(MOTOR_LEFT_A, 0);
      analogWrite(MOTOR_LEFT_B, 0);
      analogWrite(MOTOR_RIGHT_A, 0);
      analogWrite(MOTOR_RIGHT_B, 0);
    }
    else if(right<150 || left<150){
      bangbang();
      digitalWrite(FRONT_RIGHT_LED, HIGH);
      digitalWrite(FRONT_LEFT_LED, HIGH);
      digitalWrite(BACK_LEFT_LED, HIGH);
      digitalWrite(BACK_RIGHT_LED, HIGH);      
     // Stop();

      analogWrite(MOTOR_LEFT_A, 0);
      analogWrite(MOTOR_LEFT_B, 0);
      analogWrite(MOTOR_RIGHT_A, 0);
      analogWrite(MOTOR_RIGHT_B, 0);
      }  
    else if(a>-10 && a<10){
     // Right();
      digitalWrite(FRONT_RIGHT_LED, LOW);
      digitalWrite(FRONT_LEFT_LED, LOW);
      digitalWrite(BACK_LEFT_LED, LOW);
      digitalWrite(BACK_RIGHT_LED, LOW);
      analogWrite(MOTOR_LEFT_A, 36-a);
      analogWrite(MOTOR_LEFT_B, 0);
      analogWrite(MOTOR_RIGHT_A, 33+a);
      analogWrite(MOTOR_RIGHT_B, 0);
      }
    
    
    else{
  //    Left();
        digitalWrite(FRONT_RIGHT_LED, LOW);
      digitalWrite(FRONT_LEFT_LED, LOW);
      digitalWrite(BACK_LEFT_LED, LOW);
      digitalWrite(BACK_RIGHT_LED, LOW);
      analogWrite(MOTOR_LEFT_A, 34);
      analogWrite(MOTOR_LEFT_B, 0);
      analogWrite(MOTOR_RIGHT_A, 36);
      analogWrite(MOTOR_RIGHT_B, 0);
        
    }
   }
 }
 void Angry()
{ 
  display.clearDisplay();
  display.drawBitmap(0, 0, angry, 128, 64, 1);
  display.display();
}

void Right(){
  display.clearDisplay();
  display.drawBitmap(0, 0, RIGHT, 128, 64, 1);
  display.display(); 
}

void Left(){
  display.clearDisplay();
  display.drawBitmap(0, 0, LEFT, 128, 64, 1);
  display.display();  
}

void Stop(){
  display.clearDisplay();
  display.drawBitmap(0, 0, STOP, 128, 64, 1);
  display.display(); 
}
